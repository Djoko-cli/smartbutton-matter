## firmware/main/Kconfig.projbuild
```kconfig
menu "SmartButton"

    choice APP_LED_MODE
        prompt "LED de l'appareil"
        default APP_LED_SIMPLE
        help
            Le PCB final a une LED simple, qui ne s'allume que brièvement à
            chaque appui. La carte de dev ESP32-H2 SuperMini a, à la place, une
            LED adressable WS2812 sur GPIO8 : elle ne se pilote pas en GPIO nu,
            et un « flash » GPIO enverrait du bruit sur sa ligne de données.

        config APP_LED_SIMPLE
            bool "LED simple (PCB final) : flash bref à chaque appui"
        config APP_LED_WS2812_WHITE
            bool "LED adressable WS2812 (SuperMini) : blanc fixe"
        config APP_LED_NONE
            bool "Aucune LED"
    endchoice

    config APP_LED_GPIO
        int "GPIO de la LED"
        depends on !APP_LED_NONE
        default 8

    config APP_LED_WS2812_LEVEL
        int "Intensité du blanc (1-255)"
        depends on APP_LED_WS2812_WHITE
        range 1 255
        default 24
        help
            24/255 donne un blanc bien visible pour ~4 mA. Pleine intensité :
            jusqu'à ~60 mA, inutile et chaud.

    menu "Pile"

        choice APP_BATTERY_SOURCE
            prompt "Source de la mesure de tension"
            default APP_BATTERY_SIMULATED
            help
                La SuperMini est alimentée en USB : il n'y a pas de pile à mesurer,
                on simule une tension pour développer la chaîne jusqu'à Maison.
                Le PCB final mesurera la pile via l'ADC, à travers un pont diviseur.

            config APP_BATTERY_SIMULATED
                bool "Tension simulée (carte de dev)"
            config APP_BATTERY_ADC
                bool "Mesure ADC à travers un pont diviseur (PCB final)"
        endchoice

        config APP_BATTERY_SIM_MV
            int "Tension simulée (mV)"
            depends on APP_BATTERY_SIMULATED
            range 1800 3300
            default 2850
            help
                2850 mV correspond à une CR2450 entamée (~80 %). Descendre sous
                2500 mV pour tester l'alerte « pile faible » dans Maison.

        config APP_BATTERY_ADC_GPIO
            int "GPIO de mesure"
            depends on APP_BATTERY_ADC
            default 1

        config APP_BATTERY_DIVIDER_X1000
            int "Rapport du pont diviseur x1000 (Vpile / Vadc)"
            depends on APP_BATTERY_ADC
            range 1000 10000
            default 2000
            help
                2000 = pont 1:2 (deux résistances égales).

        config APP_BATTERY_PERIOD_MIN
            int "Période de mesure (minutes)"
            range 1 1440
            default 360
            help
                Une mesure réveille la puce et peut déclencher un rapport radio
                si la valeur change : toutes les 6 h, c'est négligeable dans le
                budget énergie (docs/02-energie.md).

    endmenu

    menu "Statistiques d'énergie"

        config APP_POWER_STATS
            bool "Journaliser périodiquement le temps éveillé et les réveils"
            depends on PM_ENABLE
            select PM_PROFILING
            default n
            help
                Lit les compteurs de gestion d'énergie d'ESP-IDF (PM_PROFILING) et
                écrit une ligne de synthèse : part du temps en veille, nombre de
                réveils, temps éveillé moyen par réveil, et une ESTIMATION de la
                charge par réveil et du courant moyen. Faute de PPK2, c'est la
                meilleure approximation disponible. À couper pour une vraie mesure.

        config APP_POWER_STATS_PERIOD_S
            int "Période de synthèse (s)"
            depends on APP_POWER_STATS
            range 30 3600
            default 300

        config APP_POWER_STATS_ACTIVE_UA
            int "Courant de référence éveillé (µA) pour l'estimation"
            depends on APP_POWER_STATS
            default 20000
            help
                Ordre de grandeur pour l'ESP32-H2 éveillé (CPU à 96 MHz, radio en
                réception) : 15 à 30 mA selon l'activité. À remplacer par une
                mesure dès que possible.

        config APP_POWER_STATS_SLEEP_UA
            int "Courant de référence en light sleep (µA) pour l'estimation"
            depends on APP_POWER_STATS
            default 28

    endmenu

endmenu
```
